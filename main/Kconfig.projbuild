## main/Kconfig.projbuild
```kconfig
menu "Xiaozhi Assistant"

config OTA_URL
    string "Default OTA URL"
    default "https://aiot.snab.win/xiaozhi/ota/"
    help
        The application will access this URL to check for new firmwares and server address.

choice
    prompt "Flash Assets"
    default FLASH_DEFAULT_ASSETS
    help
        Select the assets to flash.

    config FLASH_NONE_ASSETS
        bool "Do not flash assets"
    config FLASH_DEFAULT_ASSETS
        bool "Flash Default Assets"
    config FLASH_CUSTOM_ASSETS
        bool "Flash Custom Assets"
endchoice

config CUSTOM_ASSETS_FILE
    depends on FLASH_CUSTOM_ASSETS
    string "Custom Assets File"
    default "assets.bin"
    help
        The custom assets file to flash.
        It can be a local file relative to the project directory or a remote url.

choice
    prompt "Default Language"
    default LANGUAGE_ZH_TW
    help
        Select device display language

    config LANGUAGE_ZH_TW
        bool "Chinese Traditional"
    config LANGUAGE_EN_US
        bool "English"
endchoice

config CONVERT_DISPLAY_TEXT_TO_TRADITIONAL
    bool "Show server Chinese text in Traditional Chinese (Taiwan)"
    default y
    depends on LANGUAGE_ZH_TW
    help
        Convert Simplified Chinese in STT, TTS subtitles and agent status from the
        server to Traditional Chinese with Taiwan vocabulary before displaying it.
        Uses OpenCC tables (about 90 KB flash). Spoken audio is not affected.

config ATOMS3R_ECHO_BASE_DISPLAY_ROTATE_180
    bool "Rotate AtomS3R display 180 degrees"
    default n
    help
        Show the AtomS3R screen upside down, for when the device is mounted
        inverted.

choice DISPLAY_STYLE
    prompt "Select display style"
    default USE_DEFAULT_MESSAGE_STYLE

    config USE_DEFAULT_MESSAGE_STYLE
        bool "Enable default message style"
    config USE_WECHAT_MESSAGE_STYLE
        bool "Enable WeChat Message Style"
endchoice

config USE_MULTILINE_CHAT_MESSAGE
    bool "Use multiline chat message display (default mode only)"
    depends on USE_DEFAULT_MESSAGE_STYLE
    default n
    help
        When enabled, the chat message area shows multiple wrapped lines that
        grow upward from the bottom of the screen.

config USE_AUDIO_PROCESSOR
    bool "Enable AFE Audio Processing"
    default y
    depends on SPIRAM
    help
        Enable the shared AFE uplink path with AEC and VAD.

config USE_DEVICE_AEC
    bool "Enable Device-Side AEC"
    default n
    depends on USE_AUDIO_PROCESSOR
    help
        Requires a clean output reference path and acoustic isolation between microphone and speaker.

config USE_SERVER_AEC
    bool "Enable Server-Side AEC (Unstable)"
    default n
    depends on USE_AUDIO_PROCESSOR
    help
        Requires server support.

config USE_AUDIO_DEBUGGER
    bool "Enable Audio Debugger"
    default n
    help
        Send audio data through UDP to the host machine.

config AUDIO_DEBUG_UDP_SERVER
    string "Audio Debug UDP Server Address"
    default "192.168.2.100:8000"
    depends on USE_AUDIO_DEBUGGER
    help
        UDP server address, format: IP:PORT

config BUTTON_ONLY_CONVERSATION
    bool "Button-only conversation"
    default n
    help
        Each button click starts one listening turn. After the reply the device
        waits with the session kept open until the next click. Only the button
        can interrupt speaking.

config USE_ESP_WAKE_WORD
    bool "Enable WakeNet wake word"
    default y

config RECEIVE_CUSTOM_MESSAGE
    bool "Enable Custom Message Reception"
    default n
    help
        Allow the device to receive custom messages from the server.

endmenu
```
